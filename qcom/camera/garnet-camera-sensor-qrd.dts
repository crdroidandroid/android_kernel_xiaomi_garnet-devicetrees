/dts-v1/;
/plugin/;

#include <dt-bindings/clock/qcom,gcc-parrot.h>
#include <dt-bindings/clock/qcom,camcc-parrot.h>
#include <dt-bindings/interconnect/qcom,parrot.h>
#include <dt-bindings/interrupt-controller/arm-gic.h>
#include <dt-bindings/regulator/qcom,rpmh-regulator-levels.h>

#include "garnet-camera-sensor-qrd.dtsi"
/ {
	model = "Qualcomm Technologies, Inc. Garnet based on SM7435";
	compatible = "qcom,parrot-qrd", "qcom,parrot", "qcom,parrotp", "qcom,parrotp-qrd", "qcom,qrd";
	qcom,msm-id = <537 0x10000>, <583 0x10000>, <613 0x10000>, <631 0x10000>,
			<633 0x10000>, <634 0x10000>, <638 0x10000>,
			<663 0x10000>, <713 0x10000>, <714 0x10000>,
			<715 0x10000>;
	qcom,board-id = <0x1000B 0x0>;
	xiaomi,miboard-id = <0x11 0x0>;
};
